/*
  Cart-Pole live demo (on-device DQN inference)

  Same network and physics as cartpole_dqn_inference.ino, but runs one
  simulated step at a time, forever, and streams a line after every step for
  tools/rl_serial_visualizer.py. For demos only; use cartpole_dqn_inference.ino
  for benchmark numbers.

  Plain Arduino-core C++: Uno/Nano, ESP8266, ESP32, STM32 (STM32duino).
  Serial: 115200 baud.

  Serial protocol
    once at boot:
      CP_INFO,<x_threshold>,<theta_threshold_rad>,<max_steps>
    after every step:
      CP,<episode>,<step>,<x>,<x_dot>,<theta>,<theta_dot>,<action>,<reward>,<total_reward>,<done>,<result>
        action : 0 = push left, 1 = push right
        done   : 1 on the last line of an episode, else 0
        result : "SOLVED" or "FAILED" on the last line, else empty

  Live control (single characters sent from the PC)
    'p' pause   'g' resume   'n' end the current episode and start a new one
*/

#include <math.h>

#if defined(__AVR__)
  #include <avr/pgmspace.h>
  #define PROGMEM_ATTR PROGMEM
  #define READ_W(ptr, idx) (pgm_read_float((ptr) + (idx)))
#else
  #define PROGMEM_ATTR
  #define READ_W(ptr, idx) ((ptr)[(idx)])
#endif

#include "cartpole_dqn_weights.h"   // generated by tools/export_weights_to_c.py

// ---------------------- Physics (matches pc/env.py) ----------------------
const float GRAVITY         = 9.8f;
const float MASSCART        = 1.0f;
const float MASSPOLE        = 0.1f;
const float TOTAL_MASS      = MASSCART + MASSPOLE;
const float LENGTH          = 0.5f;   // half the pole length
const float POLEMASS_LENGTH = MASSPOLE * LENGTH;
const float FORCE_MAG       = 10.0f;
const float TAU             = 0.02f;  // seconds per step

const float THETA_THRESHOLD = 12.0f * 2.0f * 3.14159265f / 360.0f;
const float X_THRESHOLD     = 2.4f;
const uint16_t MAX_STEPS    = 200;

// ---------------------- Demo pacing ----------------------
// Inference takes microseconds; these delays only make the stream watchable.
const uint16_t STEP_DELAY_MS        = 40;
const uint16_t EPISODE_END_PAUSE_MS = 1000;

const int MAX_UNITS = 24;   // largest layer width in this network

// ---------------------- Global state ----------------------
float cartX, cartXDot, poleTheta, poleThetaDot;
uint16_t stepCount;
uint32_t episodeCount = 0;
float    totalReward = 0.0f;
bool     paused = false;

float bufA[MAX_UNITS], bufB[MAX_UNITS];

// ---------------------- PRNG (xorshift32) ----------------------
uint32_t rngState;

uint32_t xorshift32() {
  rngState ^= rngState << 13;
  rngState ^= rngState >> 17;
  rngState ^= rngState << 5;
  return rngState;
}

float randUnit()   { return (xorshift32() >> 8) / 16777216.0f; }  // [0, 1)
float randSmall()  { return (randUnit() - 0.5f) * 0.1f; }         // [-0.05, 0.05)

// ---------------------- Environment ----------------------
void envReset() {
  cartX        = randSmall();
  cartXDot     = randSmall();
  poleTheta    = randSmall();
  poleThetaDot = randSmall();
  stepCount    = 0;
  totalReward  = 0.0f;
}

float envStep(uint8_t action, bool &done) {
  stepCount++;

  float force    = (action == 1) ? FORCE_MAG : -FORCE_MAG;
  float costheta = cosf(poleTheta);
  float sintheta = sinf(poleTheta);

  float temp = (force + POLEMASS_LENGTH * poleThetaDot * poleThetaDot * sintheta) / TOTAL_MASS;
  float thetaAcc = (GRAVITY * sintheta - costheta * temp) /
                   (LENGTH * (4.0f / 3.0f - MASSPOLE * costheta * costheta / TOTAL_MASS));
  float xAcc = temp - POLEMASS_LENGTH * thetaAcc * costheta / TOTAL_MASS;

  cartX        += TAU * cartXDot;
  cartXDot     += TAU * xAcc;
  poleTheta    += TAU * poleThetaDot;
  poleThetaDot += TAU * thetaAcc;

  bool terminated = (cartX < -X_THRESHOLD || cartX > X_THRESHOLD ||
                     poleTheta < -THETA_THRESHOLD || poleTheta > THETA_THRESHOLD);
  bool truncated  = (stepCount >= MAX_STEPS);
  done = terminated || truncated;
  return 1.0f;
}

// ---------------------- Network forward pass ----------------------
// W is stored PyTorch-style: [out_dim, in_dim], row-major.
void denseLayer(const float *in, int inDim, const float *W, const float *b,
                int outDim, float *out, bool applyRelu) {
  for (int o = 0; o < outDim; o++) {
    float sum = READ_W(b, o);
    for (int i = 0; i < inDim; i++) {
      sum += READ_W(W, (long)o * inDim + i) * in[i];
    }
    out[o] = applyRelu ? (sum > 0.0f ? sum : 0.0f) : sum;
  }
}

uint8_t forwardPassAction(const float *state) {
  denseLayer(state, cartpole_layer0_in, cartpole_layer0_W, cartpole_layer0_b,
             cartpole_layer0_out, bufA, true);
  denseLayer(bufA, cartpole_layer1_in, cartpole_layer1_W, cartpole_layer1_b,
             cartpole_layer1_out, bufB, true);
  denseLayer(bufB, cartpole_layer2_in, cartpole_layer2_W, cartpole_layer2_b,
             cartpole_layer2_out, bufA, false);   // raw Q-values

  uint8_t best = 0;
  for (uint8_t a = 1; a < (uint8_t)cartpole_layer2_out; a++)
    if (bufA[a] > bufA[best]) best = a;
  return best;
}

// ---------------------- Serial helpers ----------------------
void handleIncomingCommands() {
  while (Serial.available() > 0) {
    char c = (char)Serial.read();
    if (c == 'p')      paused = true;
    else if (c == 'g') paused = false;
    else if (c == 'n') stepCount = MAX_STEPS;   // makes the next envStep() end the episode
  }
}

void sendStepLine(uint8_t action, float reward, bool done, const char *result) {
  Serial.print(F("CP,"));
  Serial.print(episodeCount);   Serial.print(',');
  Serial.print(stepCount);      Serial.print(',');
  Serial.print(cartX, 4);       Serial.print(',');
  Serial.print(cartXDot, 4);    Serial.print(',');
  Serial.print(poleTheta, 4);   Serial.print(',');
  Serial.print(poleThetaDot, 4); Serial.print(',');
  Serial.print(action);         Serial.print(',');
  Serial.print(reward, 2);      Serial.print(',');
  Serial.print(totalReward, 2); Serial.print(',');
  Serial.print(done ? 1 : 0);   Serial.print(',');
  Serial.println(result);
}

// ---------------------- Arduino entry points ----------------------
void setup() {
  Serial.begin(115200);
  while (!Serial) { ; }

  // seed from a floating analog pin + timer
  rngState = analogRead(A0) * 2654435761u + micros();
  if (rngState == 0) rngState = 0xA5A5A5A5;

  Serial.println(F("=== Cart-Pole live demo (on-device DQN inference) ==="));
  Serial.print(F("CP_INFO,"));
  Serial.print(X_THRESHOLD, 3);     Serial.print(',');
  Serial.print(THETA_THRESHOLD, 4); Serial.print(',');
  Serial.println(MAX_STEPS);

  envReset();
}

void loop() {
  handleIncomingCommands();
  if (paused) { delay(20); return; }

  float state[4] = { cartX, cartXDot, poleTheta, poleThetaDot };
  uint8_t action = forwardPassAction(state);

  bool done = false;
  float reward = envStep(action, done);
  totalReward += reward;

  const char *result = "";
  if (done) result = (totalReward >= MAX_STEPS) ? "SOLVED" : "FAILED";
  sendStepLine(action, reward, done, result);

  if (done) {
    delay(EPISODE_END_PAUSE_MS);
    episodeCount++;
    envReset();
  } else {
    delay(STEP_DELAY_MS);
  }
}
