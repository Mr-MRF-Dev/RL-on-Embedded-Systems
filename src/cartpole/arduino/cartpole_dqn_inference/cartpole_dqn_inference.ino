/*
  Cart-Pole on-device DQN inference

  Runs only the forward pass of a network trained on the PC (pc/train_dqn.py).
  Weights come from cartpole_dqn_weights.h and are kept in flash (PROGMEM on
  AVR), so even an Arduino Uno fits: the network has 770 parameters (3080 bytes
  as float32) and only ~100 bytes of RAM are used for activations.

  Plain Arduino-core C++: Uno/Nano, ESP8266, ESP32, STM32 (STM32duino).
  Serial: 115200 baud.

  To regenerate the weights header:
    python tools/export_weights_to_c.py cartpole/pc/weights/cartpole_dqn.pt cartpole_dqn_weights.h cartpole

  Output (CSV): network parameter count, then over N_EVAL_EPISODES greedy
  episodes: mean_return, std_return, solved_rate and the average inference
  latency per step in microseconds (network forward pass only).
*/

#include <math.h>

#if defined(__AVR__)
  #include <avr/pgmspace.h>
  #define PROGMEM_ATTR PROGMEM
  #define READ_W(ptr, idx) (pgm_read_float((ptr) + (idx)))
#else
  #define PROGMEM_ATTR
  #define READ_W(ptr, idx) ((ptr)[(idx)])
#endif

#include "cartpole_dqn_weights.h"   // generated by tools/export_weights_to_c.py

// ---------------------- Physics (matches pc/env.py) ----------------------
const float GRAVITY         = 9.8f;
const float MASSCART        = 1.0f;
const float MASSPOLE        = 0.1f;
const float TOTAL_MASS      = MASSCART + MASSPOLE;
const float LENGTH          = 0.5f;   // half the pole length
const float POLEMASS_LENGTH = MASSPOLE * LENGTH;
const float FORCE_MAG       = 10.0f;
const float TAU             = 0.02f;  // seconds per step

const float THETA_THRESHOLD = 12.0f * 2.0f * 3.14159265f / 360.0f;
const float X_THRESHOLD     = 2.4f;
const uint16_t MAX_STEPS    = 200;

const uint32_t N_EVAL_EPISODES = 100;
const int MAX_UNITS = 24;   // largest layer width in this network

// ---------------------- Global state ----------------------
float cartX, cartXDot, poleTheta, poleThetaDot;
uint16_t stepCount;

float bufA[MAX_UNITS], bufB[MAX_UNITS];

// ---------------------- PRNG (xorshift32) ----------------------
uint32_t rngState;

uint32_t xorshift32() {
  rngState ^= rngState << 13;
  rngState ^= rngState >> 17;
  rngState ^= rngState << 5;
  return rngState;
}

float randUnit()   { return (xorshift32() >> 8) / 16777216.0f; }  // [0, 1)
float randSmall()  { return (randUnit() - 0.5f) * 0.1f; }         // [-0.05, 0.05)

// ---------------------- Environment ----------------------
void envReset() {
  cartX        = randSmall();
  cartXDot     = randSmall();
  poleTheta    = randSmall();
  poleThetaDot = randSmall();
  stepCount    = 0;
}

float envStep(uint8_t action, bool &done) {
  stepCount++;

  float force    = (action == 1) ? FORCE_MAG : -FORCE_MAG;
  float costheta = cosf(poleTheta);
  float sintheta = sinf(poleTheta);

  float temp = (force + POLEMASS_LENGTH * poleThetaDot * poleThetaDot * sintheta) / TOTAL_MASS;
  float thetaAcc = (GRAVITY * sintheta - costheta * temp) /
                   (LENGTH * (4.0f / 3.0f - MASSPOLE * costheta * costheta / TOTAL_MASS));
  float xAcc = temp - POLEMASS_LENGTH * thetaAcc * costheta / TOTAL_MASS;

  cartX        += TAU * cartXDot;
  cartXDot     += TAU * xAcc;
  poleTheta    += TAU * poleThetaDot;
  poleThetaDot += TAU * thetaAcc;

  bool terminated = (cartX < -X_THRESHOLD || cartX > X_THRESHOLD ||
                     poleTheta < -THETA_THRESHOLD || poleTheta > THETA_THRESHOLD);
  bool truncated  = (stepCount >= MAX_STEPS);
  done = terminated || truncated;
  return 1.0f;
}

// ---------------------- Network forward pass ----------------------
// out[o] = bias[o] + sum_i in[i] * W[o * in_dim + i], optionally followed by ReLU.
// W is stored PyTorch-style: [out_dim, in_dim], row-major.
void denseLayer(const float *in, int inDim, const float *W, const float *b,
                int outDim, float *out, bool applyRelu) {
  for (int o = 0; o < outDim; o++) {
    float sum = READ_W(b, o);
    for (int i = 0; i < inDim; i++) {
      sum += READ_W(W, (long)o * inDim + i) * in[i];
    }
    out[o] = applyRelu ? (sum > 0.0f ? sum : 0.0f) : sum;
  }
}

uint8_t forwardPassAction(const float *state) {
  denseLayer(state, cartpole_layer0_in, cartpole_layer0_W, cartpole_layer0_b,
             cartpole_layer0_out, bufA, true);
  denseLayer(bufA, cartpole_layer1_in, cartpole_layer1_W, cartpole_layer1_b,
             cartpole_layer1_out, bufB, true);
  denseLayer(bufB, cartpole_layer2_in, cartpole_layer2_W, cartpole_layer2_b,
             cartpole_layer2_out, bufA, false);   // raw Q-values

  uint8_t best = 0;
  for (uint8_t a = 1; a < (uint8_t)cartpole_layer2_out; a++)
    if (bufA[a] > bufA[best]) best = a;
  return best;
}

int paramCount() {
  return cartpole_layer0_in * cartpole_layer0_out + cartpole_layer0_out +
         cartpole_layer1_in * cartpole_layer1_out + cartpole_layer1_out +
         cartpole_layer2_in * cartpole_layer2_out + cartpole_layer2_out;
}

float stdDev(float sum, float sumSq, float n) {
  float m = sum / n;
  float variance = (sumSq / n) - (m * m);
  return sqrt(variance > 0.0f ? variance : 0.0f);
}

// ---------------------- Arduino entry points ----------------------
void setup() {
  Serial.begin(115200);
  while (!Serial) { ; }

  // seed from a floating analog pin + timer
  rngState = analogRead(A0) * 2654435761u + micros();
  if (rngState == 0) rngState = 0xA5A5A5A5;

  Serial.println(F("=== Cart-Pole on-device DQN INFERENCE (weights trained on PC) ==="));
  Serial.print(F("network parameter count: "));
  Serial.println(paramCount());

  float returnSum = 0.0f, returnSumSq = 0.0f;
  uint32_t solvedCount = 0;
  uint64_t inferenceTimeUs = 0;
  uint32_t inferenceCount = 0;

  for (uint32_t ep = 0; ep < N_EVAL_EPISODES; ep++) {
    envReset();
    bool done = false;
    float totalReward = 0.0f;

    while (!done) {
      yield();   // keep ESP8266/ESP32 watchdogs happy during the long loop

      float state[4] = { cartX, cartXDot, poleTheta, poleThetaDot };

      uint32_t t0 = micros();
      uint8_t action = forwardPassAction(state);
      uint32_t t1 = micros();
      inferenceTimeUs += (t1 - t0);
      inferenceCount++;

      totalReward += envStep(action, done);
    }

    returnSum   += totalReward;
    returnSumSq += totalReward * totalReward;
    if (totalReward >= MAX_STEPS) solvedCount++;
  }

  float n = (float)N_EVAL_EPISODES;
  Serial.println(F("=== evaluation summary (100 episodes, on-device inference) ==="));
  Serial.println(F("mean_return,std_return,solved_rate,avg_inference_us"));
  Serial.print(returnSum / n);                         Serial.print(',');
  Serial.print(stdDev(returnSum, returnSumSq, n));     Serial.print(',');
  Serial.print((float)solvedCount / n, 4);             Serial.print(',');
  Serial.println((float)inferenceTimeUs / inferenceCount, 2);
}

void loop() { }
