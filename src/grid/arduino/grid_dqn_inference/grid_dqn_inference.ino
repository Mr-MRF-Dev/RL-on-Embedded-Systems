/*
  Grid-World on-device DQN inference

  Runs only the forward pass of a network trained on the PC (pc/train_dqn.py).
  Weights come from grid_dqn_weights.h and are kept in flash (PROGMEM on AVR).
  The network has 388 parameters (1552 bytes) regardless of the grid size.

  Plain Arduino-core C++: Uno/Nano, ESP8266, ESP32, STM32 (STM32duino).
  Serial: 115200 baud.

  GRID_N must match the grid size the loaded weights were trained for. To
  regenerate the weights header:
    python tools/export_weights_to_c.py grid/pc/weights/grid_dqn_n30.pt grid_dqn_weights.h grid

  Output (CSV): GRID_N and network parameter count, then over N_EVAL_EPISODES
  greedy episodes: mean_return, std_return, mean_steps, goal_reach_rate and the
  average inference latency per step in microseconds (forward pass only).
*/

#include <math.h>

#if defined(__AVR__)
  #include <avr/pgmspace.h>
  #define PROGMEM_ATTR PROGMEM
  #define READ_W(ptr, idx) (pgm_read_float((ptr) + (idx)))
#else
  #define PROGMEM_ATTR
  #define READ_W(ptr, idx) ((ptr)[(idx)])
#endif

#include "grid_dqn_weights.h"   // generated by tools/export_weights_to_c.py

// ---------------------- Configuration ----------------------
const uint16_t GRID_N = 30;   // must match the trained weights

// ---------------------- Problem definition (matches pc/env.py) ----------------------
const float STEP_COST         = -1.0f;
const float WALL_BUMP_PENALTY = -2.0f;
const float GOAL_REWARD       = 50.0f;
const uint16_t MAX_STEPS      = (6 * GRID_N > 50) ? (6 * GRID_N) : 50;

const uint32_t N_EVAL_EPISODES = 100;
const int MAX_UNITS = 16;   // largest layer width in this network

// ---------------------- Global state ----------------------
int16_t  agentRow, agentCol;
uint16_t stepCount;

float bufA[MAX_UNITS], bufB[MAX_UNITS];

// ---------------------- Environment ----------------------
void envReset() {
  agentRow  = 0;
  agentCol  = 0;
  stepCount = 0;
}

// action: 0 = Up, 1 = Down, 2 = Left, 3 = Right
float envStep(uint8_t action, bool &terminated, bool &done) {
  stepCount++;
  int16_t oldRow = agentRow, oldCol = agentCol;

  if      (action == 0) agentRow -= 1;
  else if (action == 1) agentRow += 1;
  else if (action == 2) agentCol -= 1;
  else                  agentCol += 1;

  bool wallBump = false;
  if (agentRow < 0 || agentRow >= (int16_t)GRID_N ||
      agentCol < 0 || agentCol >= (int16_t)GRID_N) {
    agentRow = oldRow;
    agentCol = oldCol;
    wallBump = true;
  }

  float reward = STEP_COST;
  if (wallBump) reward += WALL_BUMP_PENALTY;

  terminated = false;
  if (agentRow == (int16_t)(GRID_N - 1) && agentCol == (int16_t)(GRID_N - 1)) {
    reward     = GOAL_REWARD;
    terminated = true;
  }
  done = terminated || (stepCount >= MAX_STEPS);
  return reward;
}

// ---------------------- Network forward pass ----------------------
// W is stored PyTorch-style: [out_dim, in_dim], row-major.
void denseLayer(const float *in, int inDim, const float *W, const float *b,
                int outDim, float *out, bool applyRelu) {
  for (int o = 0; o < outDim; o++) {
    float sum = READ_W(b, o);
    for (int i = 0; i < inDim; i++) {
      sum += READ_W(W, (long)o * inDim + i) * in[i];
    }
    out[o] = applyRelu ? (sum > 0.0f ? sum : 0.0f) : sum;
  }
}

uint8_t forwardPassAction(const float *state) {
  denseLayer(state, grid_layer0_in, grid_layer0_W, grid_layer0_b,
             grid_layer0_out, bufA, true);
  denseLayer(bufA, grid_layer1_in, grid_layer1_W, grid_layer1_b,
             grid_layer1_out, bufB, true);
  denseLayer(bufB, grid_layer2_in, grid_layer2_W, grid_layer2_b,
             grid_layer2_out, bufA, false);   // raw Q-values

  uint8_t best = 0;
  for (uint8_t a = 1; a < (uint8_t)grid_layer2_out; a++)
    if (bufA[a] > bufA[best]) best = a;
  return best;
}

int paramCount() {
  return grid_layer0_in * grid_layer0_out + grid_layer0_out +
         grid_layer1_in * grid_layer1_out + grid_layer1_out +
         grid_layer2_in * grid_layer2_out + grid_layer2_out;
}

float stdDev(float sum, float sumSq, float n) {
  float m = sum / n;
  float variance = (sumSq / n) - (m * m);
  return sqrt(variance > 0.0f ? variance : 0.0f);
}

// ---------------------- Arduino entry points ----------------------
void setup() {
  Serial.begin(115200);
  while (!Serial) { ; }

  Serial.println(F("=== Grid-World on-device DQN INFERENCE (weights trained on PC) ==="));
  Serial.print(F("GRID_N: ")); Serial.println(GRID_N);
  Serial.print(F("network parameter count: "));
  Serial.println(paramCount());

  float returnSum = 0.0f, returnSumSq = 0.0f, stepsSum = 0.0f;
  uint32_t goalReached = 0;
  uint64_t inferenceTimeUs = 0;
  uint32_t inferenceCount = 0;

  for (uint32_t ep = 0; ep < N_EVAL_EPISODES; ep++) {
    envReset();
    bool done = false, terminated = false;
    float totalReward = 0.0f;

    while (!done) {
      yield();   // keep ESP8266/ESP32 watchdogs happy during the long loop

      float state[2] = { (float)agentRow / (GRID_N - 1), (float)agentCol / (GRID_N - 1) };

      uint32_t t0 = micros();
      uint8_t action = forwardPassAction(state);
      uint32_t t1 = micros();
      inferenceTimeUs += (t1 - t0);
      inferenceCount++;

      totalReward += envStep(action, terminated, done);
    }

    returnSum   += totalReward;
    returnSumSq += totalReward * totalReward;
    stepsSum    += stepCount;
    if (terminated) goalReached++;
  }

  float n = (float)N_EVAL_EPISODES;
  Serial.println(F("=== evaluation summary (100 episodes, on-device inference) ==="));
  Serial.println(F("mean_return,std_return,mean_steps,goal_reach_rate,avg_inference_us"));
  Serial.print(returnSum / n);                       Serial.print(',');
  Serial.print(stdDev(returnSum, returnSumSq, n));   Serial.print(',');
  Serial.print(stepsSum / n);                        Serial.print(',');
  Serial.print((float)goalReached / n, 4);           Serial.print(',');
  Serial.println((float)inferenceTimeUs / inferenceCount, 2);
}

void loop() { }
