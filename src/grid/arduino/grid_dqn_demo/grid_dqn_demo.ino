/*
  Grid-World live demo (on-device DQN inference)

  Same network and environment as grid_dqn_inference.ino, but runs one
  simulated step at a time, forever, and streams a line after every step for
  tools/rl_serial_visualizer.py. For demos only; use grid_dqn_inference.ino
  for benchmark numbers.

  Plain Arduino-core C++: Uno/Nano, ESP8266, ESP32, STM32 (STM32duino).
  Serial: 115200 baud.

  GRID_N must match the grid size the loaded weights were trained for.

  Serial protocol
    once at boot:
      GRID_INFO,<grid_n>,<max_steps>
    after every step:
      GRID,<episode>,<step>,<row>,<col>,<action>,<reward>,<total_reward>,<done>,<result>
        action : 0 = Up, 1 = Down, 2 = Left, 3 = Right
        done   : 1 on the last line of an episode, else 0
        result : "GOAL" or "TIMEOUT" on the last line, else empty

  Live control (single characters sent from the PC)
    'p' pause   'g' resume   'n' end the current episode and start a new one
*/

#include <math.h>

#if defined(__AVR__)
  #include <avr/pgmspace.h>
  #define PROGMEM_ATTR PROGMEM
  #define READ_W(ptr, idx) (pgm_read_float((ptr) + (idx)))
#else
  #define PROGMEM_ATTR
  #define READ_W(ptr, idx) ((ptr)[(idx)])
#endif

#include "grid_dqn_weights.h"   // generated by tools/export_weights_to_c.py

// ---------------------- Configuration ----------------------
const uint16_t GRID_N = 30;   // must match the trained weights

// ---------------------- Problem definition (matches pc/env.py) ----------------------
const float STEP_COST         = -1.0f;
const float WALL_BUMP_PENALTY = -2.0f;
const float GOAL_REWARD       = 50.0f;
const uint16_t MAX_STEPS      = (6 * GRID_N > 50) ? (6 * GRID_N) : 50;

// ---------------------- Demo pacing ----------------------
// Inference takes microseconds; these delays only make the stream watchable.
const uint16_t STEP_DELAY_MS        = 120;
const uint16_t EPISODE_END_PAUSE_MS = 1000;

const int MAX_UNITS = 16;   // largest layer width in this network

// ---------------------- Global state ----------------------
int16_t  agentRow, agentCol;
uint16_t stepCount;
uint32_t episodeCount = 0;
float    totalReward = 0.0f;
bool     paused = false;

float bufA[MAX_UNITS], bufB[MAX_UNITS];

// ---------------------- Environment ----------------------
void envReset() {
  agentRow    = 0;
  agentCol    = 0;
  stepCount   = 0;
  totalReward = 0.0f;
}

// action: 0 = Up, 1 = Down, 2 = Left, 3 = Right
float envStep(uint8_t action, bool &terminated, bool &done) {
  stepCount++;
  int16_t oldRow = agentRow, oldCol = agentCol;

  if      (action == 0) agentRow -= 1;
  else if (action == 1) agentRow += 1;
  else if (action == 2) agentCol -= 1;
  else                  agentCol += 1;

  bool wallBump = false;
  if (agentRow < 0 || agentRow >= (int16_t)GRID_N ||
      agentCol < 0 || agentCol >= (int16_t)GRID_N) {
    agentRow = oldRow;
    agentCol = oldCol;
    wallBump = true;
  }

  float reward = STEP_COST;
  if (wallBump) reward += WALL_BUMP_PENALTY;

  terminated = false;
  if (agentRow == (int16_t)(GRID_N - 1) && agentCol == (int16_t)(GRID_N - 1)) {
    reward     = GOAL_REWARD;
    terminated = true;
  }
  done = terminated || (stepCount >= MAX_STEPS);
  return reward;
}

// ---------------------- Network forward pass ----------------------
// W is stored PyTorch-style: [out_dim, in_dim], row-major.
void denseLayer(const float *in, int inDim, const float *W, const float *b,
                int outDim, float *out, bool applyRelu) {
  for (int o = 0; o < outDim; o++) {
    float sum = READ_W(b, o);
    for (int i = 0; i < inDim; i++) {
      sum += READ_W(W, (long)o * inDim + i) * in[i];
    }
    out[o] = applyRelu ? (sum > 0.0f ? sum : 0.0f) : sum;
  }
}

uint8_t forwardPassAction(const float *state) {
  denseLayer(state, grid_layer0_in, grid_layer0_W, grid_layer0_b,
             grid_layer0_out, bufA, true);
  denseLayer(bufA, grid_layer1_in, grid_layer1_W, grid_layer1_b,
             grid_layer1_out, bufB, true);
  denseLayer(bufB, grid_layer2_in, grid_layer2_W, grid_layer2_b,
             grid_layer2_out, bufA, false);   // raw Q-values

  uint8_t best = 0;
  for (uint8_t a = 1; a < (uint8_t)grid_layer2_out; a++)
    if (bufA[a] > bufA[best]) best = a;
  return best;
}

// ---------------------- Serial helpers ----------------------
void handleIncomingCommands() {
  while (Serial.available() > 0) {
    char c = (char)Serial.read();
    if (c == 'p')      paused = true;
    else if (c == 'g') paused = false;
    else if (c == 'n') stepCount = MAX_STEPS;   // makes the next envStep() end the episode
  }
}

void sendStepLine(uint8_t action, float reward, bool done, const char *result) {
  Serial.print(F("GRID,"));
  Serial.print(episodeCount);   Serial.print(',');
  Serial.print(stepCount);      Serial.print(',');
  Serial.print(agentRow);       Serial.print(',');
  Serial.print(agentCol);       Serial.print(',');
  Serial.print(action);         Serial.print(',');
  Serial.print(reward, 2);      Serial.print(',');
  Serial.print(totalReward, 2); Serial.print(',');
  Serial.print(done ? 1 : 0);   Serial.print(',');
  Serial.println(result);
}

// ---------------------- Arduino entry points ----------------------
void setup() {
  Serial.begin(115200);
  while (!Serial) { ; }

  Serial.println(F("=== Grid-World live demo (on-device DQN inference) ==="));
  Serial.print(F("GRID_INFO,"));
  Serial.print(GRID_N); Serial.print(',');
  Serial.println(MAX_STEPS);

  envReset();
}

void loop() {
  handleIncomingCommands();
  if (paused) { delay(20); return; }

  float state[2] = { (float)agentRow / (GRID_N - 1), (float)agentCol / (GRID_N - 1) };
  uint8_t action = forwardPassAction(state);

  bool terminated = false, done = false;
  float reward = envStep(action, terminated, done);
  totalReward += reward;

  const char *result = "";
  if (done) result = terminated ? "GOAL" : "TIMEOUT";
  sendStepLine(action, reward, done, result);

  if (done) {
    delay(EPISODE_END_PAUSE_MS);
    episodeCount++;
    envReset();
  } else {
    delay(STEP_DELAY_MS);
  }
}
